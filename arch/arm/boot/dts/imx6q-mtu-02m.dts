/*
 * Copyright (C) 2014 Variscite, Ltd. All Rights Reserved
 * Donio Ron: ron.d@variscite.com
 *
 * Copyright 2012 Freescale Semiconductor, Inc.
 * Copyright 2011 Linaro Ltd.
 *
 * The code contained herein is licensed under the GNU General Public
 * License. You may obtain a copy of the GNU General Public License
 * Version 2 or later at the following locations:
 *
 * http://www.opensource.org/licenses/gpl-license.html
 * http://www.gnu.org/copyleft/gpl.html
 */

#define VAR_SOM_MX6_V2

#include "imx6q-mtu-02.dts"

/ {
	model = "Variscite i.MX6 QUAD/DUAL VAR-SOM-MX6 V2";
	compatible = "fsl,mtu-02", "fsl,imx6q-var-som", "fsl,imx6q";
};

